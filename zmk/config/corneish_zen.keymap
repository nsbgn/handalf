#include <behaviors.dtsi>
#include <dt-bindings/zmk/keys.h>
#include <dt-bindings/zmk/bt.h>
#include <dt-bindings/zmk/outputs.h>

// Layer definitions
#define QWERTY 0
#define COLEMAK 1
#define COMPAT 2
#define SYM 3
#define SYM_COMPAT 4
#define FN 5
#define FN_COMPAT 6
#define MEDIA 7
#define MEDIA_COMPAT 8
#define SYS 9

// Convenience macros
#define UNMOD(NODE_NAME, ACTION) \
    NODE_NAME: NODE_NAME { \
        compatible = "zmk,behavior-mod-morph"; \
        #binding-cells = <0>; \
        bindings = <ACTION>, <&trans>; \
        mods = <(MOD_LGUI|MOD_LCTL)>; \
        keep-mods = <(MOD_LGUI|MOD_LCTL)>; \
    };

#define SYSCOMBO(NAME, KEYPOS, ACTION) \
    combo_ ## NAME { \
        timeout-ms = <100>; \
        key-positions = <KEYPOS>; \
        layers = <SYS>; \
        bindings = <ACTION>; \
    };

// * * *

&sk {
    release-after-ms = <200>;
    quick-release;
};

&mt {
    hold-while-undecided;
};

// The default tap-preferred flavor for &lt gets you into situations where you
// tap shorter than the tapping-term-ms (resulting in esc/cancel), followed by
// an immediate press of the next key. This gets interpreted in the terminal
// and messes things up in vim. It would be safe to introduce a delay between
// them, to accommodate fast continuation after esc, but I haven't found a
// clean way to implement that and it seems the intention is usually to go into
// the Fn layer, anyway.
&lt {
    flavor = "hold-preferred";
};

/ {
    chosen {
        zmk,physical-layout = &foostan_corne_6col_layout;
    };

    conditional_layers {
        compatible = "zmk,conditional-layers";
        media_layer {
            if-layers = <FN SYM>;
            then-layer = <MEDIA>;
        };
        sym_compat_layer {
            if-layers = <SYM COMPAT>;
            then-layer = <SYM_COMPAT>;
        };
        fn_compat_layer {
            if-layers = <FN COMPAT>;
            then-layer = <FN_COMPAT>;
        };
        media_compat_layer {
            if-layers = <FN SYM COMPAT>;
            then-layer = <MEDIA_COMPAT>;
        };
    };

    macros {
        // Select a Bluetooth profile and immediately clear it
        btclr: btclr {
            compatible = "zmk,behavior-macro-one-param";
            #binding-cells = <1>;
            bindings
                = <&macro_param_1to1>
                , <&macro_tap &bt BT_SEL MACRO_PLACEHOLDER>
                , <&macro_tap &bt BT_CLR>
                ;
        };

        // Activate both a layer and a key
        kp_mo: kp_mo {
            compatible = "zmk,behavior-macro-two-param";
            #binding-cells = <2>;
            bindings
                = <&macro_param_1to1>
                , <&macro_press &kp MACRO_PLACEHOLDER>
                , <&macro_param_2to1>
                , <&macro_press &mo MACRO_PLACEHOLDER>
             // we add this one to cancel potential responses when the
             // key from the first param is pressed on its own
                , <&macro_tap &kp LCTRL>
                , <&macro_pause_for_release>
                , <&macro_param_1to1>
                , <&macro_release &kp MACRO_PLACEHOLDER>
                , <&macro_param_2to1>
                , <&macro_release &mo MACRO_PLACEHOLDER>
                ;
        };

        // Activate a layer and immediately tap a key
        mo_tap: mo_tap {
            compatible = "zmk,behavior-macro-two-param";
            #binding-cells = <2>;
            bindings
                = <&macro_param_1to1>
                , <&macro_press &mo MACRO_PLACEHOLDER>
                , <&macro_param_2to1>
                , <&macro_tap &kp MACRO_PLACEHOLDER>
                , <&macro_pause_for_release>
                , <&macro_param_1to1>
                , <&macro_release &mo MACRO_PLACEHOLDER>
                ;
        };

    };

    behaviors {

    // For predictability, our symbol modifiers and layers will only be sticky
    // if they aren't combined with any other modifier
        lsft_mod: lsft_mod {
            compatible = "zmk,behavior-mod-morph";
            #binding-cells = <0>;
            bindings = <&sk LSFT>, <&kp LSFT>;
            mods = <0x8f>;
            keep-mods = <0x8f>;
        };
        sym_mod: sym_mod {
            compatible = "zmk,behavior-mod-morph";
            #binding-cells = <0>;
            bindings = <&sl SYM>, <&mo SYM>;
            mods = <0x8f>;
            keep-mods = <0x8f>;
        };
        rsft_mod: rsft_mod {
            compatible = "zmk,behavior-mod-morph";
            #binding-cells = <0>;
            bindings = <&sk RSFT>, <&kp RSFT>;
            mods = <0x8f>;
            keep-mods = <0x8f>;
        };

    // The SYM layer is a compromise: ideally, you would map its keys on the
    // software level (ie associate AltGr with the appropriate Level-3 symbols
    // in XKB), but this requires configuration on the device you're using. So,
    // for compatibility, we do it on the firmware level. However, then you
    // lose the 'real' AltGr, which might be needed for some reason or other.
    // Therefore, the first tap on SYM gets you the SYM layer; the second tap
    // gives you the 'real' AltGr; and the third tap gets you the two of them
    // combined (so that you can still get AltGr+5, for example). In the
    // case that the XKB layout is installed, you shouldn't need to think
    // about this --- the resulting symbols should be indistinguishable.
        sym_tapdance: sym_tapdance {
            compatible = "zmk,behavior-tap-dance";
            #binding-cells = <0>;
            tapping-term-ms = <200>;
            bindings = <&sym_mod>, <&kp RALT>, <&kp_mo RALT SYM>;
        };

    // For various reasons, having a left Shift in the usual spot is useful, as
    // it allows you to eg hold Shift while clicking the mouse with the right
    // hand. But we also don't want to let a good spot go to waste for a
    // duplicate.
    //
    // The backslash key that is next to left shift on ISO keyboards, keycode
    // `NUBS`, is a good candidate for the Compose key because it is not used
    // for anything else in our layout, its canonical position is already more
    // or less where we want it to be, and there exists a standard XKB option
    // for it (namely `compose:102`). We would like to overload it onto the
    // left Shift to make that key as useful as possible without losing left
    // Shift completely.
    //
    // When combined with one of the thumb letter modifiers (right Shift or
    // Sym/AltGr), it should immediately resolve to NUBS, because there is no
    // reason to combine shift with those, and it is common to need these
    // modifiers for the key following Compose. Conversely, there is no reason
    // to press the Compose key with any other modifier, so in those cases, it
    // should resolve to LSHFT.
    //
    // Note: I alternatively considered that this key could yield a decimal
    // point in the Sym layer and an underscore in the Shift modifier. This is
    // useful because these keys are often needed while in a different layer.
        bmt: bmt {
            compatible = "zmk,behavior-hold-tap";
            #binding-cells = <2>;
            flavor = "hold-preferred";
            tapping-term-ms = <200>;
            bindings = <&kp>, <&kp>;
            display-name = "Mod-Tap";
            hold-trigger-key-positions = <0 1 2 3 4 5 6 7 8 9 10 11 12 13 14 15 16 17 18 19 20 21 22 23 24 25 26 27 28 29 30 31 32 33 34 35 36 37 38 41>;
        };
        nubs: nubs {
            compatible = "zmk,behavior-mod-morph";
            #binding-cells = <0>;
            bindings = <&bmt LSHFT NUBS>, <&kp NUBS>;
            mods = <(MOD_RSFT|MOD_RALT)>;
            keep-mods = <(MOD_RSFT|MOD_RALT)>;
        };
        lsft_nubs: lsft_nubs {
            compatible = "zmk,behavior-mod-morph";
            #binding-cells = <0>;
            bindings = <&nubs>, <&kp LSHFT>;
            mods = <(MOD_LALT|MOD_LCTL|MOD_RCTL|MOD_LGUI|MOD_RGUI)>;
            keep-mods = <(MOD_LALT|MOD_LCTL|MOD_RCTL|MOD_LGUI|MOD_RGUI)>;
        };

    // Backslash: the backslash should be produced even while pressing the
    // Shift or AltGr modifiers. It would be sensible to do this on the
    // software level (ie. XKB), but instead we do it here so that we can still
    // also emit Shift+backslash in the stock US layout to produce the pipe |
    // symbol there.
        backslash: backslash {
            compatible = "zmk,behavior-mod-morph";
            #binding-cells = <0>;
            bindings = <&kp BSLH>, <&kp BSLH>;
            mods = <(MOD_LSFT|MOD_RSFT|MOD_RALT)>;
        };

    // Pressing Tab in the FN layer will press Alt+Tab (or Shift+Alt+Tab if
    // Shift or SYM were pressed) and keep Alt active as long as FN is active
    // or until you press some other non-modifier key. This keeps the window
    // overview active, just as it would if you pressed Alt+Tab normally.
        alttab_swapper: alttab_swapper {
            compatible = "zmk,behavior-smart-toggle";
            #binding-cells = <0>;
            bindings = <&kp LALT>, <&kp TAB>;
            ignored-key-positions = <36 39 40 41>;
        };
        alttab_shift_swapper: alttab_shift_swapper {
            compatible = "zmk,behavior-smart-toggle";
            #binding-cells = <0>;
            bindings = <&kp LALT>, <&kp RS(TAB)>;
            ignored-key-positions = <36 39 40 41>;
        };

    // Toggling a layer on or off
        togon: toggle_layer_on_only {
            compatible = "zmk,behavior-toggle-layer";
            #binding-cells = <1>;
            display-name = "Toggle Layer On";
            toggle-mode = "on";
            /* locking; for next version*/
        };
        togoff: toggle_layer_off_only {
            compatible = "zmk,behavior-toggle-layer";
            #binding-cells = <1>;
            display-name = "Toggle Layer Off";
            toggle-mode = "off";
            /* locking; for next version*/
        };

    // * * *

    // Here, we define keys that only trigger if they are not modded by LCTL or
    // LGUI. This makes it possible to hide these modifiers in the FN layer,
    // without worrying about whether FN is still active or not. A side
    // effect is that it becomes impossible to combine FN keys with these 
    // modifiers, but RCTL and RGUI are still available for that.

        UNMOD(fn01,  &kp ESC )
        UNMOD(fn02,  &kp HOME )
        UNMOD(fn03,  &kp UP )
        UNMOD(fn04,  &kp END )
        UNMOD(fn05,  &kp PG_UP )
        UNMOD(fn06,  &kp LG(LA(Y)) )
        UNMOD(fn07,  &kp LG(LA(U)) )
        UNMOD(fn08,  &kp LG(LA(I)) )
        UNMOD(fn09,  &kp LG(LA(O)) )
        UNMOD(fn10,  &kp LG(LA(P)) )
        UNMOD(fn11,  &kp LG(LA(RET)) )

        /* UNMOD(fn12, &kp BSPC ) */
        UNMOD(fn13,  &sk LCTL )
        UNMOD(fn14,  &kp LEFT )
        UNMOD(fn15,  &kp DOWN )
        UNMOD(fn16,  &kp RIGHT )
        UNMOD(fn17,  &kp PG_DN )
        UNMOD(fn18,  &kp LG(LA(H)) )
        UNMOD(fn19,  &kp LG(LA(J)) )
        UNMOD(fn20,  &kp LG(LA(K)) )
        UNMOD(fn21,  &kp LG(LA(L)) )
        UNMOD(fn22,  &kp LG(LA(SEMI)) )
        UNMOD(fn23,  &kp LG(LA(SQT)) )

        /* UNMOD(fn24, &kp LSHFT ) */
        UNMOD(fn25,  &kp LGUI )
        UNMOD(fn26,  &kp K_CUT )
        UNMOD(fn26c, &kp LC(X) )
        UNMOD(fn27,  &kp K_COPY )
        UNMOD(fn27c, &kp LC(C) )
        UNMOD(fn28,  &kp K_PASTE )
        UNMOD(fn28c, &kp LC(V) )
        UNMOD(fn29,  &kp DEL )
        UNMOD(fn30,  &kp LG(LA(N)) )
        UNMOD(fn31,  &kp LG(LA(M)) )
        UNMOD(fn32,  &kp LG(LA(COMMA)) )
        UNMOD(fn33,  &kp LG(LA(DOT)) )
        UNMOD(fn34,  &kp LG(LA(FSLH)) )
        UNMOD(fn35,  &kp LG(LA(BSLH)) )

        UNMOD(md01,  &kp LA(F4) )
        UNMOD(md02,  &kp C_PREV )
        UNMOD(md03,  &kp C_VOL_UP )
        UNMOD(md04,  &kp C_NEXT )
        UNMOD(md05,  &kp C_BRI_UP )
        UNMOD(md06,  &kp F12 )
        UNMOD(md07,  &kp F7 )
        UNMOD(md08,  &kp F8 )
        UNMOD(md09,  &kp F9 )
        UNMOD(md10,  &kp PAUSE_BREAK )
        UNMOD(md11,  &kp INS )

        /* UNMOD(md12, &kp BSPC ) */
        /* UNMOD(md13,  &kp LCTL ) */
        UNMOD(md14,  &kp C_RW )
        UNMOD(md15,  &kp C_VOL_DN )
        UNMOD(md16,  &kp C_FF )
        UNMOD(md17,  &kp C_BRI_DN )
        UNMOD(md18,  &kp F11 )
        UNMOD(md19,  &kp F4 )
        UNMOD(md20,  &kp F5 )
        UNMOD(md21,  &kp F6 )
        UNMOD(md22,  &kp PSCRN )
        UNMOD(md23,  &kp K_CMENU )

        /* UNMOD(md24, &kp LSHFT ) */
        /* UNMOD(md25,  &kp LGUI ) */
        UNMOD(md26,  &kp C_PAUSE )
        UNMOD(md27,  &kp C_MUTE )
        UNMOD(md28,  &kp C_PLAY )
        UNMOD(md29,  &kp K_LOCK )
        UNMOD(md29c, &kp LG(L) )
        UNMOD(md30,  &kp F10 )
        UNMOD(md31,  &kp F1 )
        UNMOD(md32,  &kp F2 )
        UNMOD(md33,  &kp F3 )
        UNMOD(md34,  &kp SLCK )
        UNMOD(md35,  &kp C_AC_SEARCH )
        UNMOD(md35c, &kp LG(S) )

    };

    combos {
        compatible = "zmk,combos";

    // Keyboard 'system' controls, like those for Bluetooth connections or
    // compatibility mode, are hidden in an effort to prevent them from
    // obscuring any other modifier combinations. During normal typing, you
    // should never be pressing multiple keys in the same column, so that's
    // what you do for these actions.
    // Furthermore, to avoid incurring any visual delay (as the keyboard
    // has to wait to see if the combo is pressed), this only works while
    // all three thumb keys on the left side are active (activating the SYS
    // layer).

        // Column L0: 0 12 24
        SYSCOMBO(softpoweroff, 0 12 24, &soft_off )
        // Column L1: 1 13 25
        // Column L2: 2 14 26
        // Column L3: 3 15 27
        // Column L4: 4 16 28
        SYSCOMBO(colemakon,  4 16, &togon COLEMAK )
        SYSCOMBO(colemakoff, 16 28, &togoff COLEMAK )
        SYSCOMBO(colemaktog, 4 16 28, &tog COLEMAK )
        // Column L5: 5 17 29
        SYSCOMBO(compaton,  5 17 29, &togon COMPAT )
        SYSCOMBO(compatoff, 17 29, &togoff COMPAT )
        SYSCOMBO(compattog, 5 17 29, &tog COMPAT )
        // Column R5: 6 18 30
        SYSCOMBO(btsel1, 6 18, &bt BT_SEL 0 )
        SYSCOMBO(btdsc1, 18 30, &bt BT_DISC 0 )
        SYSCOMBO(btclr1, 6 18 30, &btclr 1 )
        // Column R4: 7 19 31
        SYSCOMBO(btsel2, 7 19, &bt BT_SEL 1 )
        SYSCOMBO(btdsc2, 19 31, &bt BT_DISC 1 )
        SYSCOMBO(btclr2, 7 19 31, &btclr 2 )
        // Column R3: 8 20 32
        SYSCOMBO(btsel3, 8 20, &bt BT_SEL 2 )
        SYSCOMBO(btdsc3, 20 32, &bt BT_DISC 2 )
        SYSCOMBO(btclr3, 8 20 32, &btclr 3 )
        // Column R2: 9 21 33
        SYSCOMBO(btsel4, 9 21, &bt BT_SEL 3 )
        SYSCOMBO(btdsc4, 21 33, &bt BT_DISC 3 )
        SYSCOMBO(btclr4, 9 21 33, &btclr 4 )
        // Column R1: 10 22 34
        SYSCOMBO(btsel5, 10 22, &bt BT_SEL 4 )
        SYSCOMBO(btdsc5, 22 34, &bt BT_DISC 4 )
        SYSCOMBO(btclr5, 10 22 34, &btclr 5 )
        // Column R0: 11 23 35
        SYSCOMBO(outputble, 11 23, &out OUT_BLE )
        SYSCOMBO(outputusb, 23 35, &out OUT_USB )
        SYSCOMBO(outputtog, 11 23 35, &out OUT_TOG )
    };

    keymap {
        compatible = "zmk,keymap";

        qwerty_layer {
            display-name = "Qwerty";
            bindings = <

&kp TAB
    &kp Q &kp W &kp E &kp R &kp T
    &kp Y &kp U &kp I &kp O &kp P
&kp RET
&kp BSPC
    &kp A &kp S &kp D &kp F &kp G
    &kp H &kp J &kp K &kp L &kp SEMI
&kp SQT
&lsft_nubs
    &kp Z &kp X &kp C     &kp V   &kp B
    &kp N &kp M &kp COMMA &kp DOT &kp FSLH
&backslash

&kp LALT  &lt FN K_STOP &kp SPACE
&rsft_mod &sym_tapdance &kp RCTL
            >;
        };

        colemak_layer {
            display-name = "Colemak-DH";
            bindings = <
&trans
    &kp Q &kp W &kp F &kp P &kp B
    &kp J &kp L &kp U &kp Y &kp SEMI
&trans
&trans
    &kp A &kp R &kp S &kp T &kp G
    &kp M &kp N &kp E &kp I &kp O
&trans
&trans
    &kp Z &kp X &kp C     &kp D   &kp V
    &kp K &kp H &kp COMMA &kp DOT &kp FSLH
&trans

&trans &trans &trans
&trans &trans &trans
            >;
        };

        compat_layer {
            display-name = "Compatibility";
            bindings = <
&trans &trans &trans &trans &trans &trans
&trans &trans &trans &trans &trans &trans

&trans &trans &trans &trans &trans &trans
&trans &trans &trans &trans &trans &trans

&trans &trans &trans &trans &trans &trans
&trans &trans &trans &trans &trans &trans

&trans &lt FN ESC &trans
&trans &trans &trans
            >;
        };

        symbol_layer {
            display-name = "Symbol";
            bindings = <
&kp LS(TAB)
    &kp EXCL  &kp LBKT &kp PLUS &kp HASH &kp RBKT
    &kp CARET &kp N7   &kp N8   &kp N9   &kp PRCNT
&kp RET
&kp BSPC
    &kp STAR &kp LPAR &kp MINUS &kp EQUAL &kp RPAR
    &kp AT   &kp N4   &kp N5    &kp N6    &kp N0
&kp GRAVE
&kp RA(NUBS)
    &kp PIPE &kp LBRC &kp DLLR &kp UNDER &kp RBRC
    &kp AMPS &kp N1   &kp N2   &kp N3    &kp TILDE
&backslash

&trans   &lt FN RA(K_STOP) &trans
&kp RSFT &trans            &trans
            >;
        };

        symbol_compat_layer {
            display-name = "Symbol (Compatibility)";
            bindings = <

&trans &trans &trans &trans &trans &trans
&trans &trans &trans &trans &trans &trans

&trans &trans &trans &trans &trans &trans
&trans &trans &trans &trans &trans &trans

&trans &trans &trans &trans &trans &trans
&trans &trans &trans &trans &trans &trans

&trans &lt FN RA(ESC) &trans
&trans &trans &trans
            >;
        };

        fn_layer {
            display-name = "Fn";
            bindings = <
&alttab_swapper
    &fn01 &fn02 &fn03 &fn04 &fn05
    &fn06 &fn07 &fn08 &fn09 &fn10
&fn11
&trans
    &fn13 &fn14 &fn15 &fn16 &fn17
    &fn18 &fn19 &fn20 &fn21 &fn22
&fn23
&mt LSHFT CAPS
    &fn25 &fn26 &fn27 &fn28 &fn29
    &fn30 &fn31 &fn32 &fn33 &fn34
&fn35

&trans &trans &lt SYS RGUI
&trans &trans &trans

// I might consider emitting AltGr+Cancel (or AltGr+Esc for compatibility) upon
// tapping Fn and Sym together and RShift+Cancel (or RShift+Esc) upon tapping
// Fn and RShift together; this happens for free for the real RShift modifier,
// but is surprisingly subtle for the Sym layer; might need more thought.
// &trans              &trans             &lt SYS RGUI
// &mt RSFT RS(K_STOP) &lt SYM RA(K_STOP) &trans
            >;
        };
        fn_compat_layer {
            display-name = "Fn (Compatibility)";
            bindings = <
&trans &trans &trans &trans &trans &trans
&trans &trans &trans &trans &trans &trans

&trans &trans &trans &trans &trans &trans
&trans &trans &trans &trans &trans &trans

&trans &trans &fn26c &fn27c &fn28c &trans
&trans &trans &trans &trans &trans &trans

&trans &trans &trans
&trans &trans &trans

// See comment in the Sym layer. Here it might be undesirable anyway because
// S-Esc might means something.
// &trans           &trans          &trans
// &mt RSFT RS(ESC) &lt SYM RA(ESC) &trans
            >;
        };
        media_layer {
            display-name = "Media";
            bindings = <
&alttab_shift_swapper
    &md01  &md02 &md03 &md04 &md05
    &md06  &md07 &md08 &md09 &md10
&md11

&trans
    &trans &md14 &md15 &md16 &md17
    &md18  &md19 &md20 &md21 &md22
&md23

&trans
    &trans &md26 &md27 &md28 &md29
    &md30  &md31 &md32 &md33 &md34
&md35

&trans &trans &trans
&trans &trans &trans
            >;
        };
        media_compat_layer {
            display-name = "Media (Compatibility)";
            bindings = <
&trans &trans &trans &trans &trans &trans
&trans &trans &trans &trans &trans &trans

&trans &trans &trans &trans &trans &trans
&trans &trans &trans &trans &trans &trans

&trans &trans &trans &trans &trans &md29c
&trans &trans &trans &trans &trans &md35c

&trans &trans &trans
&trans &trans &trans
            >;
        };

    // This layer is almost just the RGUI key, but it will *also* activate a
    // transparent layer that is used for determining whether combos may
    // activate.
        system_layer {
            display-name = "System";
            bindings = <

&kp RG(TAB)
    &kp RG(Q) &kp RG(W) &kp RG(E) &kp RG(R) &kp RG(T)
    &kp RG(Y) &kp RG(U) &kp RG(I) &kp RG(O) &kp RG(P)
&kp RG(RET)
&kp RG(BSPC)
    &kp RG(A) &kp RG(S) &kp RG(D) &kp RG(F) &kp RG(G)
    &kp RG(H) &kp RG(J) &kp RG(K) &kp RG(L) &kp RG(SEMI)
&kp RG(SQT)
&trans
    &kp RG(Z) &kp RG(X) &kp RG(C)     &kp RG(V)   &kp RG(B)
    &kp RG(N) &kp RG(M) &kp RG(COMMA) &kp RG(DOT) &kp RG(FSLH)
&trans

&trans &trans &trans
&trans &trans &trans
            >;
        };
    };
};
